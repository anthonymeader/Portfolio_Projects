#include "socfpga_cyclone5_de0.dtsi"

/{
    /************************************************************/
    /* Add your device tree node                                */
    /* for your Platform Designer component here                */
    /* Example node with naming convention:                     */
    /************************************************************/
    /* 	my_label: platform_designer_name@component_address {    */
    /*      compatible = "my_initials,platform_designer_name";  */
    /*      reg = <component_address length>;                   */
    /*  };                                                      */
    /************************************************************/

    HPS_LED_Patterns: HPS_LED_Patterns@ff200000 {    
	    compatible = "ajm,HPS_LED_Patterns";  
	    reg = <0xff200000 0x10>; 
    };

};

&spi0 {
    status = "okay";
};

